## boards/buzzverse/lora_node/Kconfig
```kconfig
# Copyright (c) 2024 BuzzVerse.
# SPDX-License-Identifier: Apache-2.0

config HEAP_MEM_POOL_ADD_SIZE_BOARD
	int
	default 4096 if BOARD_LORA_NODE_ESP32S3_PROCPU
```

## boards/buzzverse/lora_node/Kconfig.lora_node
```kconfig
# BuzzVers ESP32S3 board configuration.

# Copyright (c) 2024 BuzzVerse.
# SPDX-License-Identifier: Apache-2.0

config BOARD_LORA_NODE
	select SOC_ESP32S3_WROOM_N16
	select SOC_ESP32S3_PROCPU if BOARD_LORA_NODE_ESP32S3_PROCPU
```

## boards/buzzverse/lora_node/board.yml
```yaml
board:
  name: lora_node
  full_name: BuzzVerse Node ESP32S3
  vendor: buzzverse
  socs:
  - name: esp32s3
```

## boards/buzzverse/lora_node/lora_node_procpu_defconfig
```kconfig
# SPDX-License-Identifier: Apache-2.0

CONFIG_MAIN_STACK_SIZE=2048

# Enable UART console on all configurations for convenience. This is usually
# done at board level upstream so that all samples output printed messages to
# the configured #zephyr,console. In production boards, this may be enabled at
# application level or in a debug configuration overlay.
CONFIG_CONSOLE=y
CONFIG_SERIAL=y
CONFIG_UART_CONSOLE=y
CONFIG_GPIO=y

CONFIG_FLASH=y
CONFIG_FLASH_PAGE_LAYOUT=y
```
